## meta-swi-virt/conf/machine/swi-virt-arm.conf
```bitbake
#@TYPE: Machine
#@NAME: swi-virt-arm
#@DESCRIPTION: Machine configuration for swi-virt systems (arm virtual platform)

require conf/machine/include/qemu.inc
require conf/machine/include/arm/armv5/tune-arm926ejs.inc

VIRT_ARCH = "arm"
require swi-virt.inc

KERNEL_IMAGETYPE = "zImage"

SERIAL_CONSOLE = "115200 ttyAMA0"
SERIAL_CONSOLES = "115200;ttyAMA0"
```

## meta-swi-virt/conf/machine/swi-virt-x86.conf
```bitbake
#@TYPE: Machine
#@NAME: swi-virt-x86
#@DESCRIPTION: Machine configuration for swi-virt systems (x86 virtual platform)

require conf/machine/qemux86.conf

VIRT_ARCH = "x86"
require swi-virt.inc

LEGATO_ROOTFS_TARGETS ?= "virt_${VIRT_ARCH}"

SERIAL_CONSOLE = "115200 ttyS0"
SERIAL_CONSOLES = "115200;ttyS0"
```

## meta-swi-virt/conf/machine/swi-virt.conf
```bitbake
#@TYPE: Machine
#@NAME: swi-virt
#@DESCRIPTION: Machine configuration for swi-virt systems (virtual platform)

require ${COREBASE}/meta/conf/machine/qemux86.conf

PREFERRED_PROVIDER_virtual/kernel ?= "linux-yocto"
PREFERRED_VERSION_linux-yocto ?= "3.4%"
```

## meta-swi-virt/conf/machine/swi-virt.inc
```bitbake
# Common definitions for swi-virt images

PREFERRED_PROVIDER_virtual/kernel ?= "linux-yocto"

PREFERRED_VERSION_readline = "5.2"

LEGATO_ROOTFS_TARGETS ?= "virt"

# Remove unneeded features
MACHINE_FEATURES_remove = "screen"
DISTRO_FEATURES_remove = "x11"

# To prevent busy-box hwclock dependency creation
MACHINE_FEATURES_BACKFILL_CONSIDERED = "rtc"

IMAGE_FSTYPES += "squashfs-lzo"
```
