## common/conf/distro/poky-swi.conf
```bitbake
require conf/distro/poky.conf
require conf/distro/include/sdkpath.inc

DISTRO = "poky-swi"
DISTROOVERRIDES = "poky"

SDKPATH_PREFIX_DEFAULT = "${@get_default_sdkpath_prefix(d)}"
SDKPATH_PREFIX ?= "${SDKPATH_PREFIX_DEFAULT}"
# SDKPATH and SDKPATHINSTALL needs to be same for virt toolchain to work
SDKPATH = "/opt/swi/${SDKPATH_PREFIX}"
SDKPATHINSTALL = "${SDKPATH}"

VIRTUAL-RUNTIME_init_manager ?= "busybox"

# Enable IPv6
DISTRO_FEATURES_append = " ipv6"

# Uncomment the following line to include Linux containers in the build.
# This requires addtion of meta-virtualization layer to the manifest.
#DISTRO_FEATURES_append = " lxc"

# Uncomment the following line to include Linux PAM suite in the build.
#DISTRO_FEATURES_append = " pam"

DISTRO_FEATURES_NATIVESDK_append = " xattr"
```

## common/conf/layer.conf
```bitbake
# We have a conf and classes directory, add to BBPATH
BBPATH .= ":${LAYERDIR}:${LAYERDIR}"

# We have a recipes directory, add to BBFILES
BBFILES += "${LAYERDIR}/recipes-*/*/*.bb \
            ${LAYERDIR}/recipes-*/*/*.bbappend"

# Script directory
META_SWI_SCRIPTS := "${LAYERDIR}/scripts"

BBFILE_COLLECTIONS += "swi"
BBFILE_PATTERN_swi := "^${LAYERDIR}/"
BBFILE_PRIORITY_swi = "8"
LAYERSERIES_COMPAT_swi = "kirkstone"

# Missing configuration in meta-oe/conf/layer.conf
PREFERRED_RPROVIDER_nativesdk-libdevmapper = "nativesdk-lvm2"
```

## conf/layer.conf
```bitbake
# We have a conf and classes directory, add to BBPATH
BBPATH .= ":${LAYERDIR}:${LAYERDIR}/common"

# We have a recipes directory, add to BBFILES
BBFILES += "${LAYERDIR}/common/recipes-*/*/*.bb \
	${LAYERDIR}/common/recipes-*/*/*.bbappend"

BBFILE_COLLECTIONS += "swi"
BBFILE_PATTERN_swi := "^${LAYERDIR}/"
BBFILE_PRIORITY_swi = "6"
```

## meta-swi-mdm9x15-fx30/conf/machine/swi-mdm9x15-fx30.conf
```bitbake
#@TYPE: Machine
#@NAME: swi-mdm9x15-fx30
#@DESCRIPTION: Machine configuration for swi-mdm9x15 systems

require conf/machine/swi-mdm9x15.conf

OVERRIDES_append = ":swi-mdm9x15"
```

## meta-swi-mdm9x15/conf/layer.conf
```bitbake
# We have a conf and classes directory, add to BBPATH
BBPATH .= ":${LAYERDIR}"

# We have a recipes directory, add to BBFILES
BBFILES += "${LAYERDIR}/recipes-*/*/*.bb \
	${LAYERDIR}/recipes-*/*/*.bbappend"

BBFILE_COLLECTIONS += "swi-mdm9x15"
BBFILE_PATTERN_swi-mdm9x15 := "^${LAYERDIR}/"
BBFILE_PRIORITY_swi-mdm9x15 = "6"
```

## meta-swi-mdm9x15/conf/machine/swi-mdm9x15.conf
```bitbake
#@TYPE: Machine
#@NAME: swi-mdm9x15
#@DESCRIPTION: Machine configuration for swi-mdm9x15 systems

# Ship all kernel modules by default. This affects only images based on
# packagegroup-base (which we are not using), which does not include the
# core-image-minimal or core-image-full-cmdline images.
# If you want these to appear in the system regardless of the base
# packages, use IMAGE_INSTALL instead.
MACHINE_EXTRA_RRECOMMENDS = " kernel-modules"

# lk bootloader is used by mdm9x15
EXTRA_IMAGEDEPENDS += "lk"

DEFAULTTUNE ?= "armv7a-neon"
include conf/machine/include/tune-cortexa8.inc

IMAGE_FSTYPES += "tar.bz2"

# For 2k page size nand flash
MKBOOTIMG_IMAGE_FLAGS_2K = ""

# For 4k page size nand flash
MKBOOTIMG_IMAGE_FLAGS_4K = "--pagesize 4096"

UBINIZE_ARGS_2k = '-m 2048 -p 128KiB -s 2048'
UBINIZE_ARGS_4k = '-m 4096 -p 256KiB -s 4096'

# Add squashfs file system
IMAGE_FSTYPES += "squashfs"
# EXTRA_IMAGECMD = "-b 65536 -info"

# UBI image generation happens in the "prepare_ubi" function
# (take a look at meta-swi/meta-swi-mdm9x15/recipes-core/images/mdm9x15-image.inc)
UBI_ROOTFS_PATH ?= "${IMGDEPLOYDIR}/${IMAGE_NAME}${IMAGE_NAME_SUFFIX}.squashfs"
UBI_ROOTFS_SIZE ?= "32MiB"

# For User1 MTD partition UBI image.
UBI_USER1_PATH ?= "${DEPLOY_DIR_IMAGE}/${IMAGE_NAME}.user1"
UBI_USER1_SIZE ?= "124MiB"

# Console used in mdm9x15 is managed by the modem through command AT!MAPUART
#SERIAL_CONSOLE = "ttyHSL1 115200 console"

PREFERRED_PROVIDER_virtual/kernel ?= "linux-yocto"
PREFERRED_VERSION_linux-yocto ?= "3.14%"

# GPLv2 readline
PREFERRED_VERSION_readline ?= "5.2"

# Known and supported kernel image types are:
# Image - uncompressed
# zImage - compressed
KERNEL_IMAGETYPE = "zImage"

# Tell the system to build device tree. Leave this empty if
# device tree is not needed. If empty, set KERNEL_ATTACHED_DEVICE_TREE
# to 0.
KERNEL_DEVICE_TREE_BLOB_NAME = "qcom-msm9615.dtb"

# Tell the system to attach device tree blob to kernel.
KERNEL_ATTACHED_DEVICE_TREE = "1"

# Various kernel boot options.

# ROOTFS is RAMDISK, attached to kernel
KERNEL_BOOT_OPTIONS_RAMDISK ?= "console=ttyHSL0,115200 console=ttyHSL1,115200 fudge_ro_rootfs=true rootfs_ro=true"

# ROOTFS is located on UBI volume, mtd3 partition. Set fudge_ro_rootfs to true, if unionfs should be mounted to help
# transition from RW to RO root file system.
KERNEL_BOOT_OPTIONS ?= "ubi.mtd=2 ubi.block=0,rootfs root=/dev/ubiblock0_0 ro rootfstype=squashfs console=ttyHSL0,115200 console=ttyHSL1,115200 fudge_ro_rootfs=true"

# Don't install the kernel image on the rootfs
RDEPENDS_kernel-base = ""

MACHINE_FEATURES = "apm usbgadget usbhost vfat alsa"

# Feature rtc creates a dependency on busybox hwclock but:
# a) rtc is not accessible
# b) hwclock use conflicts with time service.
# This line prevents rtc feature being backfilled.
MACHINE_FEATURES_BACKFILL_CONSIDERED = "rtc"

# Define SIERRA for userspace application
TARGET_CPPFLAGS = "-DSIERRA"

# Legato targets supported by this platform
LEGATO_ROOTFS_TARGETS ?= "wp85"
```

## meta-swi-mdm9x15/recipes-core/busybox/busybox-1.22.1/defconfig
```kconfig
CONFIG_FEATURE_PS_TIME=Y
CONFIG_FEATURE_PS_ADDITIONAL_COLUMNS=Y

CONFIG_HEAD=y
CONFIG_FEATURE_FANCY_HEAD=Y
```

## meta-swi-mdm9x28-ar758x/conf/machine/swi-mdm9x28-ar758x-qemu.conf
```bitbake
#@TYPE: Machine
#@NAME: swi-mdm9x28-qemu
#@DESCRIPTION: Machine configuration for swi-mdm9x28/qemu systems
require conf/machine/swi-mdm9x28-ar758x.conf

# Beginning of the qemu recipes
GENERIC_BASEMACHINE = "mdm9x28"

# Qemu buid enable
QEMU_BUILD = "on"

# Add a generic override for Qemu and the initial machine without Qemu
OVERRIDES_append = ":swi-qemu:swi-mdm9x28-ar758x"

# If "on" Dm-verity will open and you should update both rootfs and kernel that are paired
# And this volume will be check by shell scripts:"build.sh"
# Set it as "DM_VERITY_ENCRYPT = off" to close Dm-verity.
DM_VERITY_ENCRYPT = "off"

# Rootfs type for Qemu
QEMU_ROOTFS_TYPE = 'ubi'
IMAGE_FSTYPES += "ubifs"

MKUBIFS_ARGS = "-m 1 -e 261888 -c 2146 -F"

UBINIZE_ARGS_2k = '-m 1 -p 128KiB'
UBINIZE_ARGS_4k = '-m 1 -p 256KiB'
```

## meta-swi-mdm9x28-ar758x/conf/machine/swi-mdm9x28-ar758x-rcy.conf
```bitbake
#@TYPE: Machine
#@NAME: swi-mdm9x28-ar758x
#@DESCRIPTION: Machine configuration for swi-mdm9x28 systems

BASEMACHINE_QCOM = "mdm9607"
MACHINE_DTS_NAME = "mdm9x28"

# Ship all kernel modules by default
MACHINE_EXTRA_RRECOMMENDS = " kernel-modules"

# lk bootloader is used by mdm9x28
EXTRA_IMAGEDEPENDS += "lk"

# Uncomment the following line to enable the hard floating point abi. Note that
# this breaks some binary libraries and 3D (neither of which ship with
# meta-yocto). For maximum compatibility, leave this disabled.
#DEFAULTTUNE ?= "cortexa8hf-neon"
include conf/machine/include/tune-cortexa8.inc

IMAGE_FSTYPES += "tar.bz2"

# If "on" Dm-verity will open and you should update both rootfs and kernel at the same time
# Set it as "DM_VERITY_ENCRYPT = off" to close Dm-verity.
DM_VERITY_ENCRYPT ?= "on"

IMAGE_ROOTFS_SIZE = "10240"

# Set file extended attributes for rootfs during compile, Default is off.
# If you want to open this feature you should define both "SMACK_ATTR_NAME" and "SMACK_ATTR_VALUE"
# Here is the sample :
# SMACK_ATTR_NAME = "SMACK64"
# SMACK_ATTR_VALUE = "_"

# For 2k page size nand flash
MKBOOTIMG_IMAGE_FLAGS_2K = ""

# For 4k page size nand flash
MKBOOTIMG_IMAGE_FLAGS_4K = "--pagesize 4096"

# Add ubifs file system
IMAGE_FSTYPES += "2k.ubifs"
IMAGE_FSTYPES += "4k.ubifs"

MKUBIFS_ARGS_2k = "-m 2048 -e 126976 -c 1208 -F"
MKUBIFS_ARGS_4k = "-m 4096 -e 253952 -c 2146 -F"

IMAGE_CMD_2k.ubifs = "mkfs.ubifs -r ${IMAGE_ROOTFS} -o ${DEPLOY_DIR_IMAGE}/${IMAGE_NAME}.rootfs.2k.ubifs ${MKUBIFS_ARGS_2k}"
IMAGE_CMD_4k.ubifs = "mkfs.ubifs -r ${IMAGE_ROOTFS} -o ${DEPLOY_DIR_IMAGE}/${IMAGE_NAME}.rootfs.4k.ubifs ${MKUBIFS_ARGS_4k}"

# Add squashfs file system
IMAGE_FSTYPES += "squashfs"
# EXTRA_IMAGECMD = "-b 65536 -info"

# UBI image generation happens in the "prepare_ubi" function
# (take a look at meta-swi/meta-swi-mdm9x28/recipes-core/images/mdm9x28-image.inc)
# rootfs size is not used for squashfs
UBI_ROOTFS_SIZE ?= "38MiB"

UBI_USRFS_PATH ?= "${DEPLOY_DIR_IMAGE}/${IMAGE_NAME}.usrfs.ubifs"

# Console used in mdm9x28 is managed by the modem through command AT!MAPUART
#SERIAL_CONSOLE = "ttyHSL1 115200 console"

PREFERRED_PROVIDER_virtual/kernel ?= "linux-quic"

# GPLv2 readline
PREFERRED_VERSION_readline ?= "5.2"

# Known and supported kernel image types are:
# Image - uncompressed
# zImage - compressed
KERNEL_IMAGETYPE = "zImage"

# Various kernel boot options.

# ROOTFS is RAMDISK, attached to kernel
KERNEL_BOOT_OPTIONS_RAMDISK ?= "console=ttyHSL0,115200 console=ttyHSL1,115200 root=/dev/ram rootfs_ro=true user1_fs=ubifs fudge_ro_rootfs=false verity=${DM_VERITY_ENCRYPT}"

# ROOTFS is located on UBI volume, mtd3 partition. Set fudge_ro_rootfs to true, if unionfs should be mounted to help
# transition from RW to RO root file system.
KERNEL_BOOT_OPTIONS ?= "ubi.mtd=13 ubi.block=0,rootfs root=/dev/ubiblock0_0 ro rootfstype=squashfs console=ttyHSL0,115200 console=ttyHSL1,115200"

# Don't install the kernel image on the rootfs
RDEPENDS_kernel-base = ""

MACHINE_FEATURES = "apm usbgadget usbhost vfat alsa"

# Feature rtc creates a dependency on busybox hwclock but:
# a) rtc is not accessible
# b) hwclock use conflicts with time service.
# This line prevents rtc feature being backfilled.
MACHINE_FEATURES_BACKFILL_CONSIDERED = "rtc"

# Define SIERRA for userspace application
TARGET_CPPFLAGS = "-DSIERRA"

# Legato targets supported by this platform
LEGATO_ROOTFS_TARGETS ?= "ar758x"
```

## meta-swi-mdm9x28-fx30/conf/layer.conf
```bitbake
# We have a conf and classes directory, add to BBPATH
BBPATH .= ":${LAYERDIR}"

# We have a recipes directory, add to BBFILES
BBFILES += "${LAYERDIR}/recipes-*/*/*.bb \
            ${LAYERDIR}/recipes-*/*/*.bbappend"

BBFILE_COLLECTIONS += "swi-mdm9x28-fx30"
BBFILE_PATTERN_swi-mdm9x28-fx30 := "^${LAYERDIR}/"
BBFILE_PRIORITY_swi-mdm9x28-fx30 = "16"
# Dependency layers, in the order: lower priority layer first.
LAYERRECOMMENDS_swi-mdm9x28-fx30 = "swi-mdm9x28-wp swi-wp"
LAYERSERIES_COMPAT_swi-mdm9x28-fx30 = "kirkstone"
```

## meta-swi-mdm9x28-fx30/conf/machine/swi-mdm9x28-fx30-qemu.conf
```bitbake
#@TYPE: Machine
#@NAME: swi-mdm9x28-fx30-qemu
#@DESCRIPTION: Machine configuration for swi-mdm9x28 systems

require conf/machine/swi-mdm9x28-qemu.conf
```

## meta-swi-mdm9x28-fx30/conf/machine/swi-mdm9x28-fx30.conf
```bitbake
#@TYPE: Machine
#@NAME: swi-mdm9x28-fx30
#@DESCRIPTION: Machine configuration for swi-mdm9x28 systems

require conf/machine/swi-mdm9x28.conf

OVERRIDES_append = "swi-mdm9x28-wp:swi-mdm9x28"
```

## meta-swi-mdm9x28/conf/layer.conf
```bitbake
# We have a conf and classes directory, add to BBPATH
BBPATH .= ":${LAYERDIR}"

# We have a recipes directory, add to BBFILES
BBFILES += "${LAYERDIR}/recipes-*/*/*.bb \
            ${LAYERDIR}/recipes-*/*/*.bbappend"

BBFILE_COLLECTIONS += "swi-mdm9x28"
BBFILE_PATTERN_swi-mdm9x28 := "^${LAYERDIR}/"
BBFILE_PRIORITY_swi-mdm9x28 = "11"
LAYERSERIES_COMPAT_swi-mdm9x28 = "zeus dunfell"
```

## meta-swi-mdm9x28/conf/machine/swi-mdm9x28-qemu.conf
```bitbake
#@TYPE: Machine
#@NAME: swi-mdm9x28-qemu
#@DESCRIPTION: Machine configuration for swi-mdm9x28/qemu systems
require conf/machine/swi-mdm9x28.conf

# Remove support for WiFi devices on qemu
MACHINE_FEATURES:remove = "tiwifi"
MACHINE_FEATURES:remove = "qcawifi"
MACHINE_FEATURES:remove = "qcabt"

# Beginning of the qemu recipes
GENERIC_BASEMACHINE = "mdm9x28"

# QEmu build enable
QEMU_BUILD = "on"

# Add a generic override for Qemu and the initial machine without Qemu
OVERRIDES:append = ":swi-qemu:swi-mdm9x28"

# If "on" Dm-verity will open and you should update both rootfs and kernel that are paired
# And this volume will be check by shell scripts:"build.sh"
# Set it as "DM_VERITY_ENCRYPT = off" to close Dm-verity.
DM_VERITY_ENCRYPT = "off"

# Rootfs type for Qemu
QEMU_ROOTFS_TYPE = 'ubi'
IMAGE_FSTYPES += "ubifs"

MKUBIFS_ARGS = "-m 1 -e 261888 -c 2146 -F"

UBINIZE_ARGS_2k = '-m 1 -p 128KiB'
UBINIZE_ARGS_4k = '-m 1 -p 256KiB'

# Legato partition is at @0x1e00000 by default. See the device tree mdm9607-swi-qemu.dts.
FLASH_LEGATO_START = "0x1e00000"
FLASH_LEGATO_SIZE = "0x8c0000"
```

## meta-swi-mdm9x28/conf/machine/swi-mdm9x28-wp.conf
```bitbake
#@TYPE: Machine
#@NAME: swi-mdm9x28-wp
#@DESCRIPTION: Machine configuration for swi-mdm9x28 wp76xx and wp77xx systems
require conf/machine/swi-mdm9x28.conf

# Beginning of the WP recipes
GENERIC_BASEMACHINE = "mdm9x28"

# Add a generic override for WP and the initial machine without WP
OVERRIDES_append = ":swi-mdm9x28-wp:swi-mdm9x28"
```
