## meta-swi-mdm9x28/conf/machine/swi-mdm9x28.conf
```bitbake
#@TYPE: Machine
#@NAME: swi-mdm9x28
#@DESCRIPTION: Machine configuration for swi-mdm9x28 systems

BASEMACHINE_QCOM = "mdm9607"
MACHINE_DTS_NAME = "mdm9x28"

# Ship all kernel modules by default
MACHINE_EXTRA_RRECOMMENDS = " kernel-modules"

# lk bootloader is used by mdm9x28
EXTRA_IMAGEDEPENDS += "lk"

# Uncomment the following line to enable the hard floating point abi. Note that
# this breaks some binary libraries and 3D (neither of which ship with
# meta-yocto). For maximum compatibility, leave this disabled.
#DEFAULTTUNE ?= "cortexa8hf-neon"
include conf/machine/include/tune-cortexa8.inc

IMAGE_FSTYPES += "tar.bz2"

# For 2k page size nand flash
YAFFS2_IMAGE_FLAGS_2K = ""
MKBOOTIMG_IMAGE_FLAGS_2K = ""

# For 4k page size nand flash
YAFFS2_IMAGE_FLAGS_4K = "-c 4096 -s 160"
MKBOOTIMG_IMAGE_FLAGS_4K = "--pagesize 4096"

# Add yaffs2 file system
IMAGE_FSTYPES += "2k.yaffs2 4k.yaffs2"
EXTRA_IMAGEDEPENDS += "yaffs2-utils-native"

# Add the yaffs2 imaging commands to the filesystem support for Bitbake as OE-Core doesn't support them directly...
IMAGE_CMD_2k.yaffs2 = "mkyaffs2image ${YAFFS2_IMAGE_FLAGS_2K} ${EXTRA_IMAGECMD} ${IMAGE_ROOTFS} ${DEPLOY_DIR_IMAGE}/${IMAGE_NAME}.rootfs.2k.yaffs2; chmod 644 ${DEPLOY_DIR_IMAGE}/${IMAGE_NAME}.rootfs.2k.yaffs2"
IMAGE_CMD_4k.yaffs2 = "mkyaffs2image ${YAFFS2_IMAGE_FLAGS_4K} ${EXTRA_IMAGECMD} ${IMAGE_ROOTFS} ${DEPLOY_DIR_IMAGE}/${IMAGE_NAME}.rootfs.4k.yaffs2; chmod 644 ${DEPLOY_DIR_IMAGE}/${IMAGE_NAME}.rootfs.4k.yaffs2"

# Add ubifs file system
IMAGE_FSTYPES += "ubifs"
MKUBIFS_ARGS = "-m 2048 -e 126976 -c 1208 -F"

# Add squashfs file system
IMAGE_FSTYPES += "squashfs"
# EXTRA_IMAGECMD = "-b 65536 -info"

# UBI image generation happens in the "prepare_ubi" function
# (take a look at meta-swi/meta-swi-mdm9x28/recipes-core/images/mdm9x28-image.inc)
# rootfs size is not used for squashfs
UBI_ROOTFS_SIZE ?= "38MiB"

UBI_USRFS_PATH ?= "${DEPLOY_DIR_IMAGE}/${IMAGE_NAME}.usrfs.ubifs"

# Console used in mdm9x28 is managed by the modem through command AT!MAPUART
#SERIAL_CONSOLE = "ttyHSL1 115200 console"

PREFERRED_PROVIDER_virtual/kernel ?= "linux-quic"

# GPLv2 readline
PREFERRED_VERSION_readline ?= "5.2"

# Known and supported kernel image types are:
# Image - uncompressed
# zImage - compressed
KERNEL_IMAGETYPE = "zImage"

# Various kernel boot options.

# ROOTFS is RW YAFFS2, mtd2 partition.
# KERNEL_BOOT_OPTIONS ?= "root=/dev/mtdblock2 rw rootfstype=yaffs2 rootflags=tags-ecc-off console=ttyHSL0,115200 console=ttyHSL1,115200"

# ROOTFS is YAFFS2, mtd2 partition, ro. Set fudge_ro_rootfs to true, if unionfs should be mounted to help
# transition from RW to RO root file system.
# KERNEL_BOOT_OPTIONS ?= "root=/dev/mtdblock2 ro rootfstype=yaffs2 rootflags=tags-ecc-off console=ttyHSL0,115200 console=ttyHSL1,115200 fudge_ro_rootfs=true"

# ROOTFS is RAMDISK, attached to kernel
KERNEL_BOOT_OPTIONS_RAMDISK ?= "console=ttyHSL0,115200 root=/dev/ram fudge_ro_rootfs=true rootfs_ro=true"

# ROOTFS is located on UBI volume, mtd3 partition. Set fudge_ro_rootfs to true, if unionfs should be mounted to help
# transition from RW to RO root file system.
KERNEL_BOOT_OPTIONS ?= "ubi.mtd=13 ubi.block=0,rootfs root=/dev/ubiblock0_0 ro rootfstype=squashfs console=ttyHSL0,115200 console=ttyHSL1,115200 fudge_ro_rootfs=true"

# Don't install the kernel image on the rootfs
RDEPENDS_kernel-base = ""

MACHINE_FEATURES = "apm usbgadget usbhost vfat alsa"

# Feature rtc creates a dependency on busybox hwclock but:
# a) rtc is not accessible
# b) hwclock use conflicts with time service.
# This line prevents rtc feature being backfilled.
MACHINE_FEATURES_BACKFILL_CONSIDERED = "rtc"

# Define SIERRA for userspace application
TARGET_CPPFLAGS = "-DSIERRA"

# Legato targets supported by this platform
LEGATO_ROOTFS_TARGETS ?= "ar758x"
```

## meta-swi-mdm9x40/conf/machine/swi-mdm9x40-ar759x-rcy.conf
```bitbake
#@TYPE: Machine
#@NAME: swi-mdm9x40-ar759x-rcy
#@DESCRIPTION: Machine configuration for swi-mdm9x40-ar759x-rcy systems

BASEMACHINE_QCOM = "mdm9640"
MACHINE_DTS_NAME = "msm9640"

# Ship all kernel modules by default
MACHINE_EXTRA_RRECOMMENDS = " kernel-modules"

# lk bootloader is used by mdm9x40
EXTRA_IMAGEDEPENDS += "lk"

DEFAULTTUNE ?= "armv7a-neon"
include conf/machine/include/tune-cortexa8.inc

# If "on" Dm-verity will open and you should update both rootfs and kernel that are paired
# And this volume will be check by shell scripts:"build.sh"
# Set it as "DM_VERITY_ENCRYPT = off" to close Dm-verity.
DM_VERITY_ENCRYPT = "on"

IMAGE_ROOTFS_SIZE = "10240"

# Set file extended attributes for rootfs during compile, Default is off.
# If you want to open this feature you should define both "SMACK_ATTR_NAME" and "SMACK_ATTR_VALUE"
# Here is the sample:
# SMACK_ATTR_NAME = "SMACK64"
# SMACK_ATTR_VALUE = "_"

IMAGE_FSTYPES += "tar.bz2"

# For 2k page size nand flash
MKBOOTIMG_IMAGE_FLAGS_2K = ""

# For 4k page size nand flash
MKBOOTIMG_IMAGE_FLAGS_4K = "--pagesize 4096"

# Add ubifs file system
IMAGE_FSTYPES += "ubifs"
MKUBIFS_ARGS = "-m 4096 -e 253952 -c 2146 -F"

# Add squashfs file system
IMAGE_FSTYPES += "squashfs"
# EXTRA_IMAGECMD = "-b 65536 -info"

# UBI image generation happens in the "prepare_ubi" function
# (take a look at meta-swi/meta-swi-mdm9x40/recipes-core/images/mdm9x40-image.inc)
# rootfs size is not used for squashfs
UBI_ROOTFS_SIZE ?= "38MiB"

UBI_USRFS_PATH ?= "${IMGDEPLOYDIR}/${IMAGE_NAME}.usrfs.ubifs"

# Console used in mdm9x40 is managed by the modem through command AT!MAPUART
#SERIAL_CONSOLE = "ttyHSL1 115200 console"

PREFERRED_PROVIDER_virtual/kernel ?= "linux-quic"

# GPLv2 readline
PREFERRED_VERSION_readline ?= "5.2"

# Known and supported kernel image types are:
# Image - uncompressed
# zImage - compressed
KERNEL_IMAGETYPE = "zImage"

# Various kernel boot options.

# ROOTFS is RAMDISK, attached to kernel
#KERNEL_BOOT_OPTIONS_RAMDISK ?= "console=ttyHSL0,115200 root=/dev/ram fudge_ro_rootfs=true rootfs_ro=true"
KERNEL_BOOT_OPTIONS_RAMDISK ?= "console=ttyHSL0,115200 console=ttyHSL1,115200 root=/dev/ram rootfs_ro=true user1_fs=ubifs verity=${DM_VERITY_ENCRYPT}"

# ROOTFS is located on UBI volume, mtd3 partition. Set fudge_ro_rootfs to true, if unionfs should be mounted to help
# transition from RW to RO root file system.
KERNEL_BOOT_OPTIONS ?= "ubi.mtd=2 ubi.block=0,rootfs root=/dev/ubiblock0_0 ro rootfstype=squashfs console=ttyHSL0,115200 console=ttyHSL1,115200"

# Don't install the kernel image on the rootfs
RDEPENDS_kernel-base = ""

MACHINE_FEATURES = "apm usbgadget usbhost vfat alsa"

# Feature rtc creates a dependency on busybox hwclock but:
# a) rtc is not accessible
# b) hwclock use conflicts with time service.
# This line prevents rtc feature being backfilled.
MACHINE_FEATURES_BACKFILL_CONSIDERED = "rtc"

# Define SIERRA for userspace application
TARGET_CPPFLAGS = "-DSIERRA"

# Legato targets supported by this platform
LEGATO_ROOTFS_TARGETS ?= "ar759x"
```

## meta-swi-mdm9xxx/conf/layer.conf
```bitbake
# We have a conf and classes directory, add to BBPATH
BBPATH .= ":${LAYERDIR}"

# We have a recipes directory, add to BBFILES
BBFILES += "${LAYERDIR}/recipes-*/*/*.bb \
            ${LAYERDIR}/recipes-*/*/*.bbappend"

BBFILE_COLLECTIONS += "swi-mdm9xxx"
BBFILE_PATTERN_swi-mdm9xxx := "^${LAYERDIR}/"
BBFILE_PRIORITY_swi-mdm9xxx = "10"
LAYERSERIES_COMPAT_swi-mdm9xxx = "zeus dunfell gatesgarth"
```

## meta-swi-s6/conf/layer.conf
```bitbake
# We have a conf and classes directory, add to BBPATH
BBPATH .= ":${LAYERDIR}"

# We have a recipes directory, add to BBFILES
BBFILES += "${LAYERDIR}/recipes-*/*/*.bb \
	${LAYERDIR}/recipes-*/*/*.bbappend"

BBFILE_COLLECTIONS += "swi-s6"
BBFILE_PATTERN_swi-s6 := "^${LAYERDIR}/"
BBFILE_PRIORITY_swi-s6 = "6"
```

## meta-swi-s6/conf/machine/swi-s6.conf
```bitbake
#@TYPE: Machine
#@NAME: swi-s6
#@DESCRIPTION: Machine configuration for swi-s6 (aka ykem) systems

# Ship all kernel modules by default
MACHINE_EXTRA_RRECOMMENDS = " kernel-modules"

#u-boot bootloader is used by swi-s6
EXTRA_IMAGEDEPENDS += "u-boot"
PREFERRED_VERSION_u-boot ?= "v2011.03%"

include conf/machine/include/tune-arm926ejs.inc

IMAGE_FSTYPES += "tar.bz2 jffs2"
EXTRA_IMAGECMD_jffs2 = "-lp "

SERIAL_CONSOLE = "ttyS0 115200 console"

PREFERRED_PROVIDER_virtual/kernel ?= "linux-yocto"
PREFERRED_VERSION_linux-yocto ?= "3.4%"

KERNEL_IMAGETYPE = "uImage"

UBOOT_MACHINE = "ykem_config"
UBOOT_ENTRYPOINT = "0x80008000"
UBOOT_LOADADDRESS = "0x80008000"
```

## meta-swi-sdx55/conf/distro/qpermissions.conf
```bitbake
USERADD_PACKAGES ?= "${PN}"

USERADD_PARAM_${PN} ?= 	" \
			-u 5002 -U leprop; \
			-u 3000 -U system; \
			-u 3001 -U radio; \
			-G leprop -u 3002 -U bluetooth; \
			-u 3003 -U graphics; \
			-u 3004 -g input input; \
			-G diag,system -u 3005 -g audio audio; \
			-G inet,system,leprop -u 3006 -U camera; \
			-u 3010 -U wifi; \
			-u 3013 -U media; \
			-u 3036 -U logd; \
			-u 2000 -U adb; \
			-G diag,inet,system,leprop -u 3011 -U sensors; \
			-u 4000 -U apps; \
			-u 9999 -U nobody; \
			-G audio,camera,system,leprop,video -u 5000 -U qmmfsvr; \
			-G audio,camera,input,system,inet,leprop,video -u 5001 -U qmmfwebsvr; \
			-G audio,camera,input,system,inet,leprop,video -u 5003 -U ipcwebsvr; \
			-u 4021 -U locclient; \
			-G system,locclient -u 1021 -U gps; \
			-G system,diag,radio -u 4023 -U mcm; \
			-u 3014 -U powermgr; \
			"

GROUPADD_PARAM_${PN} ?=	" \
                        -g 2901 kmsg; \
			-g 3004 net_raw; \
			-g 3005 net_admin; \
			-g 3009 readproc; \
			-g 3010 wakelock; \
			-g 3013 qwes; \
			-g 3014 diag; \
			-g 3015 inet; \
			"
```

## meta-swi-sdx55/conf/layer.conf
```bitbake
# We have a conf and classes directory, add to BBPATH
BBPATH .= ":${LAYERDIR}"

# We have a recipes directory, add to BBFILES
BBFILES += "${LAYERDIR}/recipes-*/*/*.bb \
            ${LAYERDIR}/recipes-*/*/*.bbappend"

BBFILE_COLLECTIONS += "swi-sdx55"
BBFILE_PATTERN_swi-sdx55 := "^${LAYERDIR}/"
BBFILE_PRIORITY_swi-sdx55 = "11"
```

## meta-swi-sdx55/conf/machine/swi-sdx55.conf
```bitbake
#@TYPE: Machine
#@NAME: swi-mdm9x40-ar759x
#@DESCRIPTION: Machine configuration for swi-mdm9x40-ar759x systems

BASEMACHINE_QCOM = "sdxprairie"
OVERRIDES_append = ":${BASEMACHINE_QCOM}"
OVERRIDES_append = ":mdm"

# Ship all kernel modules by default
MACHINE_EXTRA_RRECOMMENDS = " kernel-modules"

include conf/machine/include/tune-cortexa8.inc

IMAGE_FSTYPES += "tar.bz2"

# If "on" Dm-verity will open and you should update both rootfs and kernel that are paired
# And this volume will be check by shell scripts:"build.sh"
# Set it as "DM_VERITY_ENCRYPT = off" to close Dm-verity.
DM_VERITY_ENCRYPT = "on"

IMAGE_ROOTFS_SIZE = "10240"

# Set file extended attributes for rootfs during compile, Default is off.
# If you want to open this feature you should define both "SMACK_ATTR_NAME" and "SMACK_ATTR_VALUE"
# Here is the sample:
# SMACK_ATTR_NAME = "SMACK64"
# SMACK_ATTR_VALUE = "_"

# For 2k page size nand flash
MKBOOTIMG_IMAGE_FLAGS_2K = "--pagesize 2048"

# For 4k page size nand flash
MKBOOTIMG_IMAGE_FLAGS_4K = "--pagesize 4096"

UBINIZE_ARGS_2k = '-m 2048 -p 128KiB -s 2048'
UBINIZE_ARGS_4k = '-m 4096 -p 256KiB -s 4096'

MKUBIFS_ARGS_2k = "-m 2048 -e 126976 -c 1208 -F"
MKUBIFS_ARGS_4k = "-m 4096 -e 253952 -c 2146 -F"

IMAGE_CMD_2k.ubifs = "mkfs.ubifs -r ${IMAGE_ROOTFS} -o ${IMGDEPLOYDIR}/${IMAGE_NAME}.rootfs.2k.ubifs ${MKUBIFS_ARGS_2k}"
IMAGE_CMD_4k.ubifs = "mkfs.ubifs -r ${IMAGE_ROOTFS} -o ${IMGDEPLOYDIR}/${IMAGE_NAME}.rootfs.4k.ubifs ${MKUBIFS_ARGS_4k}"

# Add squashfs file system
IMAGE_FSTYPES += "squashfs 2k.ubifs 4k.ubifs"
# EXTRA_IMAGECMD = "-b 65536 -info"

# rootfs size is not used for squashfs
UBI_ROOTFS_SIZE ?= "60MiB"

PREFERRED_PROVIDER_virtual/kernel ?= "linux-msm"
PREFERRED_VERSION_linux-msm = "4.14"

# readonly-rootfs
DISTRO_FEATURES_append = " ro-rootfs"

# GPLv2 readline
PREFERRED_VERSION_readline ?= "5.2"

# Kernel config
KERNEL_CONFIG ?= "sdxprairie_defconfig"

# Known and supported kernel image types are:
# Image - uncompressed
# zImage - compressed
KERNEL_IMAGETYPE = "zImage-dtb"
MACHINE_KERNEL_BASE = "0x80000000"
MACHINE_KERNEL_TAGS_OFFSET = "0x82000000"

# Linux libc headers version
PREFERRED_VERSION_linux-msm = "4.14%"
# TODO: sdx55: 4.14%
LINUXLIBCVERSION = "5.0%"

# Various kernel boot options.

# ROOTFS is RAMDISK, attached to kernel
KERNEL_BOOT_OPTIONS_RAMDISK ?= "root=/dev/ram rootfs_ro=true console=ttyMSM0,115200 verity=${DM_VERITY_ENCRYPT}"

# ROOTFS in UBI volume
KERNEL_BOOT_OPTIONS ?= "skip_initramfs ro rootwait console=ttyMSM0,115200,n8"

# Don't install the kernel image on the rootfs
RDEPENDS_${KERNEL_PACKAGE_NAME}-base = ""

MACHINE_FEATURES = "apm usbgadget usbhost vfat alsa ipa-offload"

# Uncomment to use dm-android-verity. Note: ANDROID_VERITY_BOOT_OPTIONS
# are used only when booting without initramfs
# MACHINE_FEATURES_append = " android-verity"
# ANDROID_VERITY_BOOT_OPTIONS = "ubi.mtd=system ubi.block=0,rootfs ro root=/dev/dm-0 dm=\"system none ro,0 1 android-verity /dev/ubiblock0_0\""

# Feature rtc creates a dependency on busybox hwclock but:
# a) rtc is not accessible
# b) hwclock use conflicts with time service.
# This line prevents rtc feature being backfilled.
MACHINE_FEATURES_BACKFILL_CONSIDERED = "rtc"

# Define SIERRA for userspace application
TARGET_CPPFLAGS = "-DSIERRA"

# Legato targets supported by this platform
LEGATO_ROOTFS_TARGETS ?= ""

export userfsdatadir = "${base_prefix}/data"
MACHINE_MNT_POINTS = "/firmware "

# MDMs are nand based targets
DISTRO_FEATURES += "nand-boot"

# Mount data to tmpfs as it includes more logs.
DISTRO_FEATURES += "userfs-in-ram"

# Fix libsystemdq build issue "configure was passed unrecognised options: sysv-compat [unknown-configure-option]"
ERROR_QA_remove = " unknown-configure-option"
WARN_QA_append = " unknown-configure-option"

# Add qti custom permissions
USERADDEXTENSION = "qpermissions"

#no-rpmb-listener-support and no-ssd-listener-support add here to fix
#qseecomd can't start issue.
##Disable rpmb listener
DISTRO_FEATURES_append = " no-rpmb-listener-support"
#
##Disable ssd listener
DISTRO_FEATURES_append = " no-ssd-listener-support"

SERIAL_CONSOLES ?= '115200;ttyMSM0'
DISTRO_NAME_append = " mdm"
```

## meta-swi-virt/conf/layer.conf
```bitbake
# We have a conf and classes directory, add to BBPATH
BBPATH .= ":${LAYERDIR}"

# We have a recipes directory, add to BBFILES
BBFILES += "${LAYERDIR}/recipes-*/*/*.bb \
            ${LAYERDIR}/recipes-*/*/*.bbappend"

BBFILE_COLLECTIONS += "swi-virt"
BBFILE_PATTERN_swi-virt := "^${LAYERDIR}/"
BBFILE_PRIORITY_swi-virt = "9"
LAYERSERIES_COMPAT_swi-virt = "kirkstone"
```
